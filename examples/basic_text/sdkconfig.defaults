## examples/basic_text/sdkconfig.defaults
```kconfig
# Target chip
CONFIG_IDF_TARGET="esp32"

# Flash
CONFIG_ESPTOOLPY_FLASHSIZE_4MB=y
CONFIG_ESPTOOLPY_FLASHMODE_QIO=y
CONFIG_ESPTOOLPY_FLASHFREQ_80M=y

# CPU frequency
CONFIG_ESP32_DEFAULT_CPU_FREQ_240=y

# Logging
CONFIG_LOG_DEFAULT_LEVEL_INFO=y
CONFIG_BOOTLOADER_LOG_LEVEL_WARN=y

# FreeRTOS tick rate
CONFIG_FREERTOS_HZ=1000
```

## examples/boardtest/main/Kconfig
```kconfig
menu "OpelXID Board Test Configuration"

config OPEL_BOARDTEST_PIN_SDA
    int "SDA GPIO Pin"
    default 9
    range 0 39
    help
        GPIO pin connected to SDA channel of your level shifter / display harness.

config OPEL_BOARDTEST_PIN_SCL
    int "SCL GPIO Pin"
    default 11
    range 0 39
    help
        GPIO pin connected to SCL channel of your level shifter / display harness.

config OPEL_BOARDTEST_PIN_MRQ
    int "MRQ GPIO Pin"
    default 13
    range 0 39
    help
        GPIO pin connected to MRQ channel of your level shifter / display harness.

config OPEL_BOARDTEST_PIN_OE
    int "OE GPIO Pin"
    default 7
    range 0 39
    help
        GPIO pin connected to the level shifter OE control.

config OPEL_BOARDTEST_OE_ACTIVE_HIGH
    bool "OE is active-high"
    default y
    help
        Enable this when OE=1 enables the level shifter. Disable for active-low OE.

endmenu
```

## examples/boardtest/main/Kconfig.projbuild
```kconfig
menu "OpelXID Board Test Configuration"

config OPEL_BOARDTEST_PIN_SDA
    int "SDA GPIO Pin"
    default 9
    range 0 39
    help
        GPIO pin connected to SDA channel of your level shifter / display harness.

config OPEL_BOARDTEST_PIN_SCL
    int "SCL GPIO Pin"
    default 11
    range 0 39
    help
        GPIO pin connected to SCL channel of your level shifter / display harness.

config OPEL_BOARDTEST_PIN_MRQ
    int "MRQ GPIO Pin"
    default 13
    range 0 39
    help
        GPIO pin connected to MRQ channel of your level shifter / display harness.

endmenu
```

## examples/boardtest/sdkconfig.defaults
```kconfig
# Target chip
CONFIG_IDF_TARGET="esp32"

# Serial console
CONFIG_ESP_CONSOLE_UART=y
CONFIG_ESP_CONSOLE_UART_BAUDRATE=115200

# Logging
CONFIG_LOG_DEFAULT_LEVEL_INFO=y
CONFIG_BOOTLOADER_LOG_LEVEL_WARN=y

# OpelXID Board Test Configuration
CONFIG_OPEL_BOARDTEST_PIN_SDA=9
CONFIG_OPEL_BOARDTEST_PIN_SCL=11
CONFIG_OPEL_BOARDTEST_PIN_MRQ=13
```

## examples/demonstration/main/Kconfig
```kconfig
menu "OpelXID Demonstration Configuration"

choice OPEL_DISPLAY_TYPE
    prompt "Display Type"
    default OPEL_DISPLAY_TYPE_TID_10
    help
        Select the Opel/Vauxhall display variant to target.

    config OPEL_DISPLAY_TYPE_TID_8
        bool "TID-8 (Astra F, Corsa B, Tigra)"
        help
            8-digit Triple Info Display.
            Slave address: 0x4A
            Frame: 2 symbol bytes + 8 data bytes

    config OPEL_DISPLAY_TYPE_TID_10
        bool "TID-10 / MID (Astra G, Corsa C, MID)"
        help
            10-digit Triple Info Display or Multi Information Display.
            Slave address: 0x4D
            Frame: 3 symbol bytes + 10 data bytes

endchoice

config OPEL_DISPLAY_PIN_SDA
    int "SDA (Data) GPIO Pin"
    default 21
    range 0 39
    help
        GPIO pin for SDA (serial data line).
        Must be open-drain capable.

config OPEL_DISPLAY_PIN_SCL
    int "SCL (Clock) GPIO Pin"
    default 22
    range 0 39
    help
        GPIO pin for SCL (serial clock line).
        Must be open-drain capable.

config OPEL_DISPLAY_PIN_MRQ
    int "MRQ (Master Request) GPIO Pin"
    default 23
    range 0 39
    help
        GPIO pin for MRQ (master request line).
        Must be open-drain capable.

endmenu
```

## examples/demonstration/sdkconfig.defaults
```kconfig
# Target chip
CONFIG_IDF_TARGET="esp32"

# Flash
CONFIG_ESPTOOLPY_FLASHSIZE_4MB=y
CONFIG_ESPTOOLPY_FLASHMODE_QIO=y
CONFIG_ESPTOOLPY_FLASHFREQ_80M=y

# CPU frequency
CONFIG_ESP32_DEFAULT_CPU_FREQ_240=y

# Logging
CONFIG_LOG_DEFAULT_LEVEL_INFO=y
CONFIG_BOOTLOADER_LOG_LEVEL_WARN=y

# FreeRTOS tick rate
CONFIG_FREERTOS_HZ=1000

# Serial console
CONFIG_ESP_CONSOLE_UART=y
CONFIG_ESP_CONSOLE_UART_BAUDRATE=115200

# OpelXID Demonstration Configuration
CONFIG_OPEL_DISPLAY_TYPE_TID_10=y
CONFIG_OPEL_DISPLAY_PIN_SDA=21
CONFIG_OPEL_DISPLAY_PIN_SCL=22
CONFIG_OPEL_DISPLAY_PIN_MRQ=23
```

## main/Kconfig.projbuild
```kconfig
menu "OpelXID Configuration"
    config OPX_DEVICE_NAME
        string "BLE device name"
        default "OpelXID"
        help
            Public GAP device name advertised to the phone app.

    config OPX_RX_QUEUE_DEPTH
        int "RX queue depth"
        default 16
        range 4 64
        help
            Number of BLE write chunks buffered between NimBLE callbacks and protocol task.
endmenu
```
